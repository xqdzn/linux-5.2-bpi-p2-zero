## Documentation/devicetree/bindings/thermal/sun8i-thermal.yaml
```yaml
# SPDX-License-Identifier: GPL-2.0
%YAML 1.2
---
$id: http://devicetree.org/schemas/thermal/sun8i-thermal.yaml#
$schema: http://devicetree.org/meta-schemas/core.yaml#

title: Allwinner SUN8I Thermal Controller Device Tree Bindings

maintainers:
  - Yangtao Li <tiny.windzz@gmail.com>

description: |-
  This describes the device tree binding for the Allwinner thermal
  controller which measures the on-SoC temperatures.

properties:
  compatible:
    enum:
      - allwinner,sun8i-h3-ths
      - allwinner,sun8i-r40-ths
      - allwinner,sun50i-a64-ths
      - allwinner,sun50i-h5-ths
      - allwinner,sun50i-h6-ths

  reg:
    maxItems: 1

  interrupts:
    maxItems: 1

  resets:
    maxItems: 1

  clocks:
    minItems: 1
    maxItems: 2
    items:
      - description: ths bus clock
      - description: ths mod clock

  clock-names:
    minItems: 1
    maxItems: 2
    items:
      - const: bus
      - const: mod

  "#thermal-sensor-cells":
    enum: [ 0, 1 ]

  nvmem-cells:
    description: ths calibrate data

  nvmem-cell-names:
    const: calib

required:
  - compatible
  - reg
  - reset
  - clocks
  - clock-names
  - interrupts
  - "#thermal-sensor-cells"

allOf:
  - if:
      properties:
        compatible:
          contains:
            const: allwinner,sun50i-h6-ths

    then:
      properties:
        clocks:
          minItems: 1
          maxItems: 1

        clock-names:
          minItems: 1
          maxItems: 1

    else:
      properties:
        clocks:
          minItems: 2
          maxItems: 2

        clock-names:
          minItems: 2
          maxItems: 2

  - if:
      properties:
        compatible:
          contains:
            const: allwinner,sun8i-h3-ths

    then:
      properties:
        "#thermal-sensor-cells":
          const: 0

    else:
      properties:
        "#thermal-sensor-cells":
          const: 1

additionalProperties: false

examples:
  - |
    ths: ths@1c25000 {
        compatible = "allwinner,sun8i-h3-ths";
        reg = <0x01c25000 0x400>;
        clocks = <&ccu CLK_BUS_THS>, <&ccu CLK_THS>;
        clock-names = "bus", "mod";
        resets = <&ccu RST_BUS_THS>;
        interrupts = <GIC_SPI 31 IRQ_TYPE_LEVEL_HIGH>;
        nvmem-cells = <&tsen_calib>;
        nvmem-cell-names = "calib";
        #thermal-sensor-cells = <0>;
    };

    sid: sid@1c14000 {
        compatible = "allwinner,sun8i-h3-sid";
        reg = <0x1c14000 0x400>;
        #address-cells = <1>;
        #size-cells = <1>;
        tsen_calib: calib@34 {
                reg = <0x34 2>;
        };
    };

  - |
    ths: ths@5070400 {
        compatible = "allwinner,sun50i-h6-ths";
        reg = <0x05070400 0x100>;
        clocks = <&ccu CLK_BUS_THS>;
        clock-names = "bus";
        resets = <&ccu RST_BUS_THS>;
        interrupts = <GIC_SPI 15 IRQ_TYPE_LEVEL_HIGH>;
        nvmem-cells = <&tsen_calib>;
        nvmem-cell-names = "calib";
        #thermal-sensor-cells = <1>;
    };

    sid: sid@3006000 {
        compatible = "allwinner,sun50i-h6-sid";
        reg = <0x03006000 0x400>;
        #address-cells = <1>;
        #size-cells = <1>;
        tsen_calib: calib@14 {
                reg = <0x14 6>;
        };
    };
...
```
